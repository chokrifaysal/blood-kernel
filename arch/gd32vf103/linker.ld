/* GD32VF103 – 128 kB flash, 32 kB SRAM, 108 MHz */
ENTRY(_start)

MEMORY
{
    FLASH (rx) : ORIGIN = 0x08000000, LENGTH = 128K
    RAM   (rwx): ORIGIN = 0x20000000, LENGTH = 32K
    QSPI  (rx) : ORIGIN = 0x90000000, LENGTH = 8M
}

_stack_top = ORIGIN(RAM) + LENGTH(RAM);
